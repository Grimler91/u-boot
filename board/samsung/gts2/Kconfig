## board/samsung/gts2/Kconfig
```kconfig
if TARGET_GTS2

config SYS_BOARD
	default "gts2"
	help
	  GTS2 is a family of Exynos5433 SoC based android tablet

config SYS_VENDOR
	default "samsung"

config SYS_CONFIG_NAME
	default "gts2"

endif
```

## configs/gts2_defconfig
```kconfig
CONFIG_ARM=y
CONFIG_ARCH_EXYNOS=y
CONFIG_SYS_TEXT_BASE=0x20080000
CONFIG_ARCH_EXYNOS5=y
CONFIG_TARGET_GTS2=y
CONFIG_DEFAULT_DEVICE_TREE="exynos5433-gts2"
CONFIG_IDENT_STRING=" for Samsung Galaxy Tab S2"
CONFIG_SYS_LOAD_ADDR=0x20080000
CONFIG_HAS_CUSTOM_SYS_INIT_SP_ADDR=y
CONFIG_CUSTOM_SYS_INIT_SP_ADDR=0x2007fff0
CONFIG_FIT=y
CONFIG_BOOTDELAY=-2
CONFIG_SYS_CONSOLE_INFO_QUIET=y
# CONFIG_DISPLAY_CPUINFO is not set
CONFIG_HUSH_PARSER=y
# CONFIG_CMD_CONSOLE is not set
# CONFIG_CMD_ELF is not set
# CONFIG_CMD_GO is not set
# CONFIG_CMD_EXPORTENV is not set
# CONFIG_CMD_IMPORTENV is not set
# CONFIG_CMD_EDITENV is not set
# CONFIG_CMD_SAVEENV is not set
# CONFIG_CMD_ENV_EXISTS is not set
# CONFIG_CMD_DM is not set
CONFIG_CMD_GPIO=y
CONFIG_CMD_GPT=y
# CONFIG_RANDOM_UUID is not set
CONFIG_CMD_I2C=y
# CONFIG_CMD_LOADB is not set
# CONFIG_CMD_LOADS is not set
CONFIG_CMD_MMC=y
CONFIG_CMD_PART=y
# CONFIG_CMD_SOURCE is not set
# CONFIG_CMD_SETEXPR is not set
# CONFIG_CMD_NET is not set
CONFIG_CMD_FS_GENERIC=y
# CONFIG_DM_DEVICE_REMOVE is not set
CONFIG_DM_I2C_GPIO=y
CONFIG_MMC_DW=y
CONFIG_USB=y
# CONFIG_SYS_WHITE_ON_BLACK is not set
# CONFIG_EFI_LOADER is not set
```
